
/*
 * Copyright (c) 2023 The ZMK Contributors
 *
 * SPDX-License-Identifier: MIT
 */

#include <behaviors.dtsi>
#include <dt-bindings/zmk/bt.h>
#include <dt-bindings/zmk/keys.h>

/* Uncomment this block if using RGB
&led_strip {
    chain-length = <6>;
    // chain-length = <31>; // Uncomment if using both per-key and underglow LEDs
    // chain-length = <25>; // Uncomment if using only per-key LEDs.
};
 */

&kscan0 {
    row-gpios =
        <&pro_micro 4 (GPIO_ACTIVE_HIGH | GPIO_PULL_DOWN)>,
        <&pro_micro 5 (GPIO_ACTIVE_HIGH | GPIO_PULL_DOWN)>,
        <&pro_micro 6 (GPIO_ACTIVE_HIGH | GPIO_PULL_DOWN)>,
        <&pro_micro 7 (GPIO_ACTIVE_HIGH | GPIO_PULL_DOWN)>;

    col-gpios =
        <&gpio1 7 GPIO_ACTIVE_HIGH>,
        <&pro_micro 16 GPIO_ACTIVE_HIGH>,
        <&pro_micro 14 GPIO_ACTIVE_HIGH>,
        <&pro_micro 15 GPIO_ACTIVE_HIGH>,
        <&pro_micro 18 GPIO_ACTIVE_HIGH>,
        <&pro_micro 19 GPIO_ACTIVE_HIGH>,
        <&pro_micro 8 GPIO_ACTIVE_HIGH>;
};


&left_encoder {
    status = "okay";
};

#include "kyrev3_common.keymap"
